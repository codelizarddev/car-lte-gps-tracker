## firmware/sdkconfig.defaults
```kconfig
# Default SDK configuration for car-lte-gps-tracker
# These values are applied when running: idf.py set-target esp32

# Target
CONFIG_IDF_TARGET="esp32"

# Flash
CONFIG_ESPTOOLPY_FLASHSIZE_4MB=y
CONFIG_ESPTOOLPY_FLASHFREQ_80M=y

# Serial console
CONFIG_ESP_CONSOLE_UART_DEFAULT=y
CONFIG_ESP_CONSOLE_UART_BAUDRATE=115200

# Logging
CONFIG_LOG_DEFAULT_LEVEL_INFO=y

# FreeRTOS
CONFIG_FREERTOS_HZ=1000
CONFIG_FREERTOS_USE_TRACE_FACILITY=y

# MQTT — use esp-mqtt component
CONFIG_MQTT_TRANSPORT_SSL=y
CONFIG_MQTT_BUFFER_SIZE=2048

# ADC calibration
CONFIG_ADC_CAL_EFUSE_TP_ENABLE=y
CONFIG_ADC_CAL_EFUSE_VREF_ENABLE=y
CONFIG_ADC_CAL_LUT_ENABLE=y

# Stack sizes
CONFIG_ESP_MAIN_TASK_STACK_SIZE=8192

# NVS
CONFIG_NVS_ENCRYPTION=n
```
